## zephyr/blinky_pwm/cmake-build-debug/Kconfig/Kconfig.soc.arch
```kconfig
osource "/home/fenix/zephyrproject/zephyr/soc/$(ARCH)/Kconfig"
osource "/home/fenix/zephyrproject/zephyr/soc/$(ARCH)/*/Kconfig"
```
